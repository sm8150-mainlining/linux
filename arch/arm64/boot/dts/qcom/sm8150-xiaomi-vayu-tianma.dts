// SPDX-License-Identifier: BSD-3-Clause
/*
 * Copyright (c) 2024, gixousiyq <xbourgleh@gmail.com>
 */

/dts-v1/;

#include "sm8150-xiaomi-vayu.dtsi"

/ {
	model = "Xiaomi POCO X3 Pro (Tianma)";
	compatible = "xiaomi,vayu", "qcom,sm8150";
};

&panel { compatible = "tianma,nt36672c"; };

&nt36672c { firmware-name = "j20s_novatek_ts_fw01.bin"; };
