## drivers/input/touchscreen/nt36672c/Kconfig
```kconfig
#
# Novatek NT36672C touchscreen driver configuration
#
config TOUCHSCREEN_NT36672C_HOSTDL_SPI
	tristate "Novatek NT36672C host download SPI driver"
	help
	  Say Y here if you have a Novatek NT36672C no flash touchscreen connected
	  to your system by SPI bus, Or say M to compile it as a module.

	  If unsure, say N.

config TOUCHSCREEN_NVT_DEBUG_FS
	bool "Touch debug interface"
	help
	  Control IRQ,suspend,sensor,debug firmware,etc.
```
